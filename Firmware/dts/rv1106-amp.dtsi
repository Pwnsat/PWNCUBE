// SPDX-License-Identifier: (GPL-2.0+ OR MIT)
/*
 * Copyright (c) 2022 Rockchip Electronics Co., Ltd.
 */

/ {
	rockchip_amp: rockchip-amp {
		compatible = "rockchip,amp";
		clocks = <&cru CLK_TIMER_ROOT>, <&cru PCLK_TIMER>, <&cru CLK_TIMER5>,
			<&cru CLK_CORE_MCU>, <&cru CLK_CORE_MCU_RTC>, <&cru PCLK_MAILBOX>;

		/*
		 * NOTE: pinning CLK_CORE_MCU to xin24m (assigned-clock-parents = <&xin24m>)
		 * was TESTED and did NOT stop the ~400 ms SCR1 halt, so the halt is not a
		 * GPLL-relock glitch on the core clock. Left unpinned.
		 */
		status = "okay";
	};
};
